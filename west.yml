## west.yml
```yaml
manifest:
  version: "0.13"

  remotes:
    - name: nxp-zephyr-workshop
      url-base: https://github.com/NXP-Research

  projects:
    - name: zs-zephyr
      remote: nxp-zephyr-workshop
      revision: c551e34b56cc3375c1503bf2143995d566bf4e8e
      import:
        name-allowlist:
          - hal_nxp
          - cmsis_6
```
